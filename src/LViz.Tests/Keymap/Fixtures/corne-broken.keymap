/*
 * Copyright (c) 2020 The ZMK Contributors
 *
 * SPDX-License-Identifier: MIT
 */

#include <dt-bindings/zmk/keys.h>
#include <dt-bindings/zmk/bt.h>
#include <dt-bindings/zmk/ext_power.h>
#include <behaviors.dtsi>

// LAYERS
#define DEFAULT 0
#define NUM     1
#define SYM     2
#define FUNC    3

// MACROS
#define SUPER LC(LSHIFT)
#define SUPER2 LA(LC(LSHIFT))

&mt {
  tapping-term-ms = <200>;
  flavor = "tap-preferred";
};

/ {
  behaviors {
    hm: homerow_mods {
      compatible = "zmk,behavior-hold-tap";
      label = "HOMEROW_MODS";
      #binding-cells = <2>;
      tapping-term-ms = <200>;
      quick-tap-ms = <0>;
      flavor = "tap-preferred";
      bindings = <&kp>, <&kp>;
    };

    td0: tap_dance_0 {
      compatible = "zmk,behavior-tap-dance";
      label = "TAP_DANCE_0";
      #binding-cells = <0>;
      tapping-term-ms = <200>;
      bindings = <&hm RGUI SEMI>, <&kp SQT>;
    };

    td1: tap_dance_1 {
      compatible = "zmk,behavior-tap-dance";
      label = "TAP_DANCE_1";
      #binding-cells = <0>;
      tapping-term-ms = <200>;
      bindings = <&mt LCTRL TAB>, <&kp ESC>;
    };
  };

  combos {
    compatible = "zmk,combos";
    combo_cword {
      timeout-ms = <50>;
      key-positions = <16 19>;
      bindings = <&caps_word>;
    };

    combo_vimwq {
      timeout-ms = <50>;
      key-positions = <1 2>;
      bindings = <&vim_quit>;
    };
  };

  macros {
        vim_quit: vim_quit {
            label = "ZM_vim_quit";
            compatible = "zmk,behavior-macro";
            #binding-cells = <0>;
            bindings
                = <&macro_tap &kp ESC &kp COLON &kp W &kp Q>;
        };
    };

  keymap {
    compatible = "zmk,keymap";

    default_layer {
      bindings = <

&none   /**/  &kp Q           &kp W       &kp E       &kp R           &kp T   /**/  &kp Y    &kp U           &kp I       &kp O       &kp P          /**/  &none
&none   /**/  &hm LGUI A      &hm LALT S  &hm LCTRL D &hm LSHIFT F    &kp G   /**/  &kp H    &hm RSHIFT J    &hm RCTRL K &hm RALT L  &td0           /**/  &none
&none   /**/  &kp Z           &kp X       &kp C       &kp V           &kp B   /**/  &kp N    &kp M           &kp COMMA   &kp DOT     &kp FSLH       /**/  &none
              &td1  &lt NUM BSPC &mt LGUI SPACE  /**/  &mt RGUI RET &lt SYM DEL &mt RALT GRAVE

      >;
    };

    num_layer {
      bindings = <

&none   /**/  &none         &kp LA(LEFT)  &kp UP        &kp LA(RIGHT) &kp PG_UP  /**/  &kp PLUS   &kp N7  &kp N8  &kp N9  &kp KP_MULT